## drivers/misc/aw8697_haptic/Kconfig
```kconfig
config AW8697_HAPTIC
    tristate "Haptic driver for awinic aw8697 series"
    depends on I2C
    help
      This option enables support for aw8697 series Haptic Driver.

config AW8697_HAPTIC_CHEN_MOD
    tristate "Haptic driver for awinic aw8697 series with chen mod"
    depends on I2C
    
    help
      This option enables support for aw8697 series Haptic Driver with Chen Mod.
```

## drivers/nfc/p73-spi/Kconfig
```kconfig
config NXP_P73_DEVICES
	bool "NXP P73/PN81A secure element driver (SPI)"
	default y
	help
	  NXP P73/PN81A eSE SPI driver for NXP NFC embedded Secure Element.
```
